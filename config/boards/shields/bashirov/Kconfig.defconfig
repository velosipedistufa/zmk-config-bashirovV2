## config/boards/shields/bashirov/Kconfig.defconfig
```kconfig
if SHIELD_BASHIROV_LEFT

config ZMK_KEYBOARD_NAME
    default "bashirov"

config ZMK_SPLIT_ROLE_CENTRAL
    default y

endif

if SHIELD_BASHIROV_LEFT || SHIELD_BASHIROV_RIGHT

config ZMK_SPLIT
    default y

endif
```

## config/boards/shields/bashirov/Kconfig.shield
```kconfig
config SHIELD_BASHIROV_LEFT
    def_bool $(shields_list_contains,bashirov_left)

config SHIELD_BASHIROV_RIGHT
    def_bool $(shields_list_contains,bashirov_right)
```
